// SPDX-License-Identifier: (GPL-2.0+ OR MIT)
/dts-v1/;

#include "rk3588-bdy-g98-rkdev.dtsi"

/ {
	model = "BDY G98(ONLY EMMC)";

	aliases {
		mmc0 = &sdhci;
		mmc1 = &sdmmc;
		mmc2 = &sdio;
	};
};

&sfc {
	status = "disabled";
};

&sdhci {
	bus-width = <8>;
	no-sdio;
	no-sd;
	non-removable;
	mmc-hs200-1_8v;
	status = "okay";
};
